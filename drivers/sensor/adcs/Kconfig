## drivers/sensor/adcs/Kconfig
```kconfig
config SENSORADC
    bool "Sensor Driver"
    default y
    depends on DT_HAS_CUSTOM_SENSORADC_ENABLED
    select ADC 
    help 
      Enable custom zephyr sensor driver 


config MQ135
    bool "Enable MQ135 Gas Sensor"
    default n

config WATER
    bool "Enable HW-038 Gas Sensor"
    default n

config SOIL
    bool "Enable SOIL-MS Gas Sensor"
    default n
```
